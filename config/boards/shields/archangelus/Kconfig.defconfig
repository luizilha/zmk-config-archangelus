## config/boards/shields/archangelus/Kconfig.defconfig
```kconfig
if SHIELD_ARCHANGELUS_LEFT

config ZMK_KEYBOARD_NAME
    default "Archangelus"

config ZMK_SPLIT_ROLE_CENTRAL
    default y

endif

if SHIELD_ARCHANGELUS_LEFT || SHIELD_ARCHANGELUS_RIGHT

config ZMK_SPLIT
    default y

endif
```

## config/boards/shields/archangelus/Kconfig.shield
```kconfig
config SHIELD_ARCHANGELUS_LEFT
    def_bool $(shields_list_contains,archangelus_left)

config SHIELD_ARCHANGELUS_RIGHT
    def_bool $(shields_list_contains,archangelus_right)

   
```
